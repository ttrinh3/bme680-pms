## main/Kconfig.projbuild
```kconfig
menu "Example Configuration"

    choice
        prompt "Enterprise configuration to be used"
        default EXAMPLE_WPA_WPA2_ENTERPRISE
        config EXAMPLE_WPA_WPA2_ENTERPRISE
            bool "WPA_WPA2_ENT"
        config EXAMPLE_WPA3_ENTERPRISE
            bool "WPA3_ENT"
        config EXAMPLE_WPA3_192BIT_ENTERPRISE
            bool "WPA3_192BIT_ENT"
            depends on IDF_TARGET_ESP32C3 || IDF_TARGET_ESP32S3
            select ESP_WIFI_GCMP_SUPPORT
            select ESP_WIFI_GMAC_SUPPORT
            select WPA_SUITE_B_192
    endchoice

    config EXAMPLE_WIFI_SSID
        string "WiFi SSID"
        default "wpa2_test"
        help
            SSID (network name) for the example to connect to.

    if EXAMPLE_WPA_WPA2_ENTERPRISE
        config EXAMPLE_VALIDATE_SERVER_CERT
            bool "Validate server"
            default y
            help
                Validate the servers' certificate using CA cert.
    endif

    if !EXAMPLE_WPA_WPA2_ENTERPRISE
        config EXAMPLE_VALIDATE_SERVER_CERT
            default y
    endif

    choice
        prompt "EAP method for the example to use"
        default EXAMPLE_EAP_METHOD_PEAP
        config EXAMPLE_EAP_METHOD_TLS
            bool "TLS"
        config EXAMPLE_EAP_METHOD_PEAP
            bool "PEAP"
        config EXAMPLE_EAP_METHOD_TTLS
            bool "TTLS"
    endchoice

    config EXAMPLE_EAP_METHOD
        int
        default 0 if EXAMPLE_EAP_METHOD_TLS
        default 1 if EXAMPLE_EAP_METHOD_PEAP
        default 2 if EXAMPLE_EAP_METHOD_TTLS

    choice
        prompt "Phase2 method for TTLS"
        depends on EXAMPLE_EAP_METHOD_TTLS
        default EXAMPLE_EAP_METHOD_TTLS_PHASE2_MSCHAPV2
        config EXAMPLE_EAP_METHOD_TTLS_PHASE2_MSCHAPV2
            bool "MSCHAPV2"
        config EXAMPLE_EAP_METHOD_TTLS_PHASE2_MSCHAP
            bool "MSCHAP"
        config EXAMPLE_EAP_METHOD_TTLS_PHASE2_PAP
            bool "PAP"
        config EXAMPLE_EAP_METHOD_TTLS_PHASE2_CHAP
            bool "CHAP"
    endchoice

    config EXAMPLE_EAP_METHOD_TTLS_PHASE_2
        int
        default 1 if EXAMPLE_EAP_METHOD_TTLS_PHASE2_MSCHAPV2
        default 2 if EXAMPLE_EAP_METHOD_TTLS_PHASE2_MSCHAP
        default 3 if EXAMPLE_EAP_METHOD_TTLS_PHASE2_PAP
        default 4 if EXAMPLE_EAP_METHOD_TTLS_PHASE2_CHAP

    config EXAMPLE_EAP_ID
        string "EAP ID"
        default "example@espressif.com"
        help
            Identity in phase 1 of EAP procedure.

    config EXAMPLE_EAP_USERNAME
        string "EAP USERNAME"
        depends on EXAMPLE_EAP_METHOD_PEAP || EXAMPLE_EAP_METHOD_TTLS
        default "espressif"
        help
            Username for EAP method (PEAP and TTLS).

    config EXAMPLE_EAP_PASSWORD
        string "EAP PASSWORD"
        depends on EXAMPLE_EAP_METHOD_PEAP || EXAMPLE_EAP_METHOD_TTLS
        default "test11"
        help
            Password for EAP method (PEAP and TTLS).

endmenu

menu "Application Configuration"

	choice DIRECTION
		prompt "Communication polarity"
		default SENDER
		help
			Select Communication polarity.
		config SENDER
			bool "As the sender"
			help
				As the sender.
		config RECEIVER
			bool "As the receiver"
			help
				As the receiver.
	endchoice

	choice FREQUENCY
		prompt "Frequency to use"
		default 433MHZ
		help
			Select Frequency to use.
		config 169MHZ
			bool "169MHz"
			help
				Frequency is 169MHz.
		config 433MHZ
			bool "433MHz"
			help
				Frequency is 433MHz.
		config 470MHZ
			bool "470MHz"
			help
				Frequency is 470MHz.
		config 866MHZ
			bool "866MHz"
			help
				Frequency is 866MHz.
		config 915MHZ
			bool "915MHz"
			help
				Frequency is 915MHz.
		config OTHER
			bool "Other"
			help
				Other Frequency.
	endchoice

	config OTHER_FREQUENCY
		depends on OTHER
		int "Frequency to use[MHz]"
		range 1 999
		default 433
		help
			Frequency to use[MHz].

	config ADVANCED
		bool "Enable Advanced settings"
		default false
		help
			Enable Advanced settings.

	config CODING_RATE
		depends on ADVANCED
		int "Error coding rate"
		range 1 4
		default 1
		help
			Error coding rate.

	config BANDWIDTH
		depends on ADVANCED
		int "Signal Bandwidth"
		range 0 9
		default 7
		help
			Signal Bandwidth.

	config SF_RATE
		depends on ADVANCED
		int "Spreading Factor"
		range 5 12
		default 7
		help
			Spreading Factor.

endmenu 

menu "LoRa Configuration"

	config GPIO_RANGE_MAX
		int
		default 33 if IDF_TARGET_ESP32
		default 46 if IDF_TARGET_ESP32S2
		default 19 if IDF_TARGET_ESP32C3
		default 48 if IDF_TARGET_ESP32S3

	config MISO_GPIO
		int "MISO GPIO"
		range 0 GPIO_RANGE_MAX
		default 19 if IDF_TARGET_ESP32
		default 37 if IDF_TARGET_ESP32S2
		default 37 if IDF_TARGET_ESP32S3
		default 18 if IDF_TARGET_ESP32C3
		help
			Pin Number to be used as the MISO SPI signal.

	config SCK_GPIO
		int "SCK GPIO"
		range 0 GPIO_RANGE_MAX
		default 18 if IDF_TARGET_ESP32
		default 36 if IDF_TARGET_ESP32S2
		default 36 if IDF_TARGET_ESP32S3
		default 10 if IDF_TARGET_ESP32C3
		help
			Pin Number to be used as the SCK SPI signal.

	config MOSI_GPIO
		int "MOSI GPIO"
		range 0 GPIO_RANGE_MAX
		default 23 if IDF_TARGET_ESP32
		default 35 if IDF_TARGET_ESP32S2
		default 35 if IDF_TARGET_ESP32S3
		default 19 if IDF_TARGET_ESP32C3
		help
			Pin Number to be used as the MOSI SPI signal.

	config CS_GPIO
		int "CS GPIO"
		range 0 GPIO_RANGE_MAX
		default 15 if IDF_TARGET_ESP32
		default 34 if IDF_TARGET_ESP32S2
		default 34 if IDF_TARGET_ESP32S3
		default 7  if IDF_TARGET_ESP32C3
		help
			Pin Number where the NCS pin of the LoRa module is connected to.

	config RST_GPIO
		int "RST GPIO"
		range 0 GPIO_RANGE_MAX
		default 16 if IDF_TARGET_ESP32
		default 38 if IDF_TARGET_ESP32S2
		default 38 if IDF_TARGET_ESP32S3
		default 8  if IDF_TARGET_ESP32C3
		help
			Pin Number where the NRST pin of the LoRa module is connected to.

	choice SPI_HOST
		prompt "SPI peripheral that controls this bus"
		default SPI2_HOST
		help
			Select SPI peripheral that controls this bus.
		config SPI2_HOST
			bool "SPI2_HOST"
			help
				Use SPI2_HOST. This is also called HSPI_HOST.
		config SPI3_HOST
			bool "SPI3_HOST"
			help
				USE SPI3_HOST. This is also called VSPI_HOST
	endchoice

endmenu
```
